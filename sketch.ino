// generated by mBlock5 for mBot
// codes make you happy

#include <MeMCore.h>
#include <Arduino.h>
#include <Wire.h>
#include <SoftwareSerial.h>

MeUltrasonicSensor ultrasonic(3);
MeLineFollower linefollower(1);
MeDCMotor motor_l(9);
MeDCMotor motor_r(10);
MeBuzzer buzzer;
MeRGBLed led(7, 2);
// 0 is both leds, 1 is right, 2 is left

void _loop();
void parseCommand(String cmd);
int mode = 2;
int last_ar = 0;

void _delay(float seconds) {
  long endTime = millis() + seconds * 1000;
  while(millis() < endTime) _loop();
}

void move(int direction, int speed) {
  int leftSpeed = 0;
  int rightSpeed = 0;
  if(direction == 1) {
    leftSpeed = speed;
    rightSpeed = speed;
  } else if(direction == 2) {
    leftSpeed = -speed;
    rightSpeed = -speed;
  } else if(direction == 3) {
    leftSpeed = -speed;
    rightSpeed = speed;
  } else if(direction == 4) {
    leftSpeed = speed;
    rightSpeed = -speed;
  }
  motor_l.run((9) == M1 ? -(leftSpeed) : (leftSpeed));
  motor_r.run((10) == M1 ? -(rightSpeed) : (rightSpeed));
}

void _loop() {}

void setup() {
  Serial.begin(57600);
  led.fillPixelsBak(0, 2, 1);
}

void loop() {
  int ar = analogRead(A7);

  if(ar == 0 && ar != last_ar) {
      delay(50);
      ar = analogRead(A7);
      if(ar == 0&&mode!=2) {
          mode = 1 - mode;
          move(1, 0);
          Serial.print("Mode switched to ");
          Serial.println(mode);
      }
  }

  last_ar = ar;
  if(Serial.available() > 0) {
    String input = Serial.readStringUntil('\n');
    if(mode==0||2) {
      parseCommand(input);
    }
    }
  if(mode==1) {
    if(15 < ultrasonic.distanceCm()){
      led.setColor(0, 255, 255, 255);
      move(1, 50 / 100.0 * 255);
    } else {
      led.setColor(0, 255, 0, 0);
      move(4, 50 / 100.0 * 255);
      _delay(0.1);
      move(4, 0);
    }
    led.show();
  }
}

void parseCommand(String cmd) {
  cmd.trim();

  if (cmd.startsWith("/color")) {
    String params = cmd.substring(7);

    int led_index = 0;
    int r = 0, g = 0, b = 0;

    int count = sscanf(params.c_str(), "%d %d %d %d", &led_index, &r, &g, &b);

    if (count == 4) {
      led.setColor(led_index, r, g, b);
      led.show();
      Serial.print("Set LED ");
      Serial.print(led_index);
      Serial.print(" to RGB(");
      Serial.print(r);
      Serial.print(", ");
      Serial.print(g);
      Serial.print(", ");
      Serial.print(b);
      Serial.println(")");
    } else {
      Serial.println("ERROR: Invalid format. Use: /color <led_index> <r> <g> <b>");
    }
  } else if (cmd.startsWith("/tone")) {
    String params = cmd.substring(6);
    int tone = 0;
    int duration = 0;

    int count = sscanf(params.c_str(), "%d %d", &tone, &duration);

    if(count == 2) {
      buzzer.tone(tone, duration);
      Serial.print("Playing tone ");
      Serial.print(tone);
      Serial.print(" for ");
      Serial.print(duration);
      Serial.println("ms");
    } else {
      Serial.println("ERROR: Invalid format. Use: /tone <tone> <duration>");
    }
  } else if (cmd.startsWith("/move")) {
    String params = cmd.substring(6);
    int dir = 0;
    int power = 50;

    int count = sscanf(params.c_str(), "%d %d", &dir, &power);

    if(count >= 1 && dir > 0 && dir <= 4) {
      if(power!=0) {
        Serial.print("Walking in direction ");
        Serial.print(dir);
        Serial.print(" at ");
        Serial.print(power);
        Serial.println("%");
        move(dir, power / 100.0 * 255);
      } else {
        Serial.println("Stopping");
        move(1, 0);
      }
    } else {
      Serial.println("ERROR: Invalid format. Use: /move <direction> or /move <direction> <power>");
    }
  } else if (cmd.startsWith("/mode")) {
    mode = 2-mode;
    Serial.print("On-board button is now ");
    if(mode) {
      Serial.println("disabled");
    } else {
      Serial.println("enabled");
    }
  } else {
    Serial.println("ERROR: Unknown command");
  }
}

// generated by mBlock5 for mBot
// codes make you happy

#include <MeMCore.h>
#include <Arduino.h>
#include <Wire.h>
#include <SoftwareSerial.h>

MeUltrasonicSensor ultrasonic(3);
MeRGBLed led(7, 2);


void _loop();

void _delay(float seconds) {
  long endTime = millis() + seconds * 1000;
  while(millis() < endTime) _loop();
}

void setup() {
  Serial.begin(57600);
  led.fillPixelsBak(0, 2, 1);
  while(1) {
      float a = ultrasonic.distanceCm();
      if(a<10){
      led.setColor(0, 255, 0, 0);
      led.show();
      }else{
      led.setColor(0, 255,255,255);
      led.show();
      }

      _loop();
  }

}

void _loop() {
}

void loop() {
  _loop();
}

